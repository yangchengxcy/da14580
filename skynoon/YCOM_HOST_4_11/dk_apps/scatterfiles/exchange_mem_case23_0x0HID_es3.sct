#! armcc -E -I .\ --cpu Cortex-M0

#include "da14580_config.h"
#include "da14580_scatter_config.h"    


; *************************************************************
; *** Scatter-Loading Description File generated by uVision ***
; *************************************************************
;
; This scatter file is set up for EM_MAP == 23!
; If an application uses a different memory layout then it must
; use a customized scatter file.
;**************************************************************

LR_IROM1 0x20000000 0x160 {                     ; load region size_region
    ER_IROM1 0x20000000 0x160 {                 ; load address = execution address
        *.o (RESET, +First)
    }
}
 
LR_IROM2 0x20000160 0x160 {
    ER_IROM2 0x20000160 0x160  {
       .ANY (jump_table_mem_area) 
    }
}

LR_IROM3 0x200002C0 0x70 {
    ER_IROM3 0x200002C0 0x70 {
        .ANY (timeout_table_area)
    }
}

LR_IROM4 0x20000340 0x100 {
    ER_IROM4 0x20000340 0x100 {
        .ANY (nvds_data_storage_area)
    }
}

LR_IROM5 0x20000440 0x7ac0 {
    ER_IROM5 0x20000440 0x7ac0 {
		*(InRoot$$Sections)				        ; All library sections that must be in a
                                                ; root region, for example, __main.o,
                                                ; __scatter*.o, __dc*.o, and * Region$$Table
        boot_vectors.o (+RO)
        system_ARMCM0.o (+RO)
        ;*armlib* (+RO)
		.ANY (+RO) 
        .ANY (+RW)
    }

    ;
    ; DB Heap
    ;
#if (DB_SIZE_BELOW_7F00 > 0)
    RW_IRAM00 (0x20007f00 - DB_SIZE_BELOW_7F00) UNINIT DB_SIZE_BELOW_7F00 {
        jump_table.o (heap_db_area)
    }
#endif


    ;
    ; ENV Heap
    ;
#if (ENV_SIZE_BELOW_7F00 > 0)
    RW_IRAM01 ENV_START_BELOW_7F00 UNINIT ENV_SIZE_BELOW_7F00 {
        jump_table.o (heap_env_area)
    }
#endif
    
    
    ;
    ; MSG Heap
    ;
#if (MSG_SIZE_BELOW_7F00 > 0)
    RW_IRAM02 MSG_START_BELOW_7F00 UNINIT MSG_SIZE_BELOW_7F00 {
        jump_table.o (heap_msg_area)
    }
#endif 
}  

; *********************************************************************************************
; * END OF OTP - ANYTHING BELOW THIS POINT IS NOT WRITTEN WHEN THE CODE IS BURNED TO THE OTP! *
; *********************************************************************************************

LR_IRAM5 0x20008000 0x1800 {
    RW_IRAM50 0x20008000 UNINIT 0x600 {                ; Stack
        .ANY (STACK)
    }

    RW_IRAM51 0x20008600 UNINIT NON_RET_HEAP_SIZE {    ; not retained HEAP
        jump_table.o (heap_mem_area_not_ret)    
    }
    
    RW_IRAM52 0x20009000 EMPTY 0x20 {}          ; reserved for ROM code  

    RW_IRAM53 
        (0x20008600 + NON_RET_HEAP_SIZE)
        (0xa00 - NON_RET_HEAP_SIZE)             ; ZI data
    {
		.ANY (+ZI)
    }

    ;
    ; DB Heap
    ;
#if (DB_SIZE_ABOVE_8000 > 0)
    RW_IRAM54 (0x20009800 - DB_SIZE_ABOVE_8000) UNINIT DB_SIZE_ABOVE_8000 {
        jump_table.o (heap_db_area)
    }
#endif

    ;
    ; ENV Heap
    ;
#if (ENV_SIZE_ABOVE_8000 > 0)      
    RW_IRAM55 ENV_START_ABOVE_8000 UNINIT ENV_SIZE_ABOVE_8000 {
        jump_table.o (heap_env_area)
    }
#endif 
    
    ;
    ; MSG Heap
    ;
#if (MSG_SIZE_ABOVE_8000 > 0)
    RW_IRAM56 MSG_START_ABOVE_8000 UNINIT MSG_SIZE_ABOVE_8000 {
        jump_table.o (heap_msg_area)
    }
#endif
    
    ;
    ; Remaining area above 0x20009020 is set as ZI
    ;
#if (USED_ABOVE_9020 < 0x7e0)
    RW_IRAM57 0x20009020 (0x7e0 - USED_ABOVE_9020) {
    #if (USE_MEMORY_MAP == EXT_SLEEP_SETUP)
        .ANY (retention_mem_area0)
    #endif
        .ANY (+ZI)
    #if ( (HAS_PRINTF) && ((0x7e0 - USED_ABOVE_9020) > 0x31C) )
        app_console.o (+RO, +RW)                ; used only when CFG_PRINTF is defined (during debugging)
    #endif        
    }
#endif
}

#if (BLE_CONNECTION_MAX_USER > 4)
LR_RETENTION_RAM1 0x000800e8 0x16c {
    ZI_RET1 0x00800e8 UNINIT 0x16c {
        .ANY (retention_mem_area1)              ; application data (up to 364 bytes!)
    }
}
#endif
    
LR_RETENTION_RAM0 0x00080768 0x2898 {
    ;------------------------------------------------------------------------------------------
    ; if Deep Sleep is not used then ER_RET0 should occupy the whole memory space 
    ; (length = 0x2898)
    ;------------------------------------------------------------------------------------------
    
#if (USE_MEMORY_MAP != EXT_SLEEP_SETUP)
    ; Deep Sleep mode
    ; RetRAM : 0x80000 - 0x82000 or 0x80000 - 0x83000 if descript re-init is used
    ZI_RET00 0x00080768 UNINIT RETRAM_LEN {     ; 0x80768 is the last address used by the ROM code
    #if (BLE_CONNECTION_MAX_USER > 4)
        arch_main.o (cs_area)
    #endif
        .ANY (retention_mem_area0)              ; application data
        ; Config #0, #1 and #2
    #if (USE_MEMORY_MAP != DEEP_SLEEP_SETUP_3)      
        jump_table.o (heap_msg_area)
    #endif
        ; Config #0, #1
    #if ( (USE_MEMORY_MAP == DEEP_SLEEP_SETUP_0) || (USE_MEMORY_MAP == DEEP_SLEEP_SETUP_1) )  
        jump_table.o (heap_env_area)
    #endif
        ; Config #0
    #if (USE_MEMORY_MAP == DEEP_SLEEP_SETUP_0)      
        jump_table.o (heap_db_area)
    #endif
    }
    
    ZI_RET01 +0 {
        .ANY (+ZI)
    }
    
#else
    ; Extended Sleep mode
    ; Extended RetRAM : 0x80000 - 0x83000
    ZI_RET00 0x00080768 UNINIT 0x2898 {         ; 0x80768 is the last address used by the ROM code
    #if (BLE_CONNECTION_MAX_USER > 4)
        arch_main.o (cs_area)
    #endif
        jump_table.o (heap_env_area)
        jump_table.o (heap_msg_area)
        jump_table.o (heap_db_area)
        .ANY (retention_mem_area0)
    }
    
    ZI_RET01 +0 {
        .ANY (+ZI)
    }
#endif

}

;LR_GUARD_RAM 0x50000000 0x0 {
    ;RW_GRAM0 0x50000000 0x0 {                   ; Make sure that nothing has been placed in here!
        ;*.o (exchange_mem_case1)
    ;}
;}    

